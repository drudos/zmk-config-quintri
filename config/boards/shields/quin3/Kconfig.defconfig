## config/boards/shields/quin3/Kconfig.defconfig
```kconfig
# Copyright (c) 2020 Pete Johanson, Kurtis Lew
# SPDX-License-Identifier: MIT

if SHIELD_QUINTRI2_LEFT

config ZMK_KEYBOARD_NAME
    default "Quin3"

config ZMK_SPLIT_ROLE_CENTRAL
    default y

endif

if SHIELD_QUIN3_LEFT || SHIELD_QUIN3_RIGHT

config ZMK_SPLIT
    default y

endif
```

## config/boards/shields/quin3/Kconfig.shield
```kconfig
# Copyright (c) 2020 Pete Johanson, Kurtis Lew
# SPDX-License-Identifier: MIT

config SHIELD_QUINTRI2_LEFT
    def_bool $(shields_list_contains,quintri2_left)

config SHIELD_QUINTRI2_RIGHT
    def_bool $(shields_list_contains,quintri2_right)
```

## config/boards/shields/quintri2/Kconfig.defconfig
```kconfig
# Copyright (c) 2020 Pete Johanson, Kurtis Lew
# SPDX-License-Identifier: MIT

if SHIELD_QUINTRI2_LEFT

config ZMK_KEYBOARD_NAME
    default "Quintri2"

config ZMK_SPLIT_ROLE_CENTRAL
    default y

endif

if SHIELD_QUINTRI2_LEFT || SHIELD_QUINTRI2_RIGHT

config ZMK_SPLIT
    default y

endif
```
